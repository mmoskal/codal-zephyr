## CMakeLists.txt
```
set(BOARD_ROOT ${CMAKE_CURRENT_LIST_DIR}/../)

include($ENV{ZEPHYR_BASE}/cmake/app/boilerplate.cmake NO_POLICY_SCOPE)
project(NONE)

target_include_directories(app PRIVATE
inc
..
../codal-core/inc/core
../codal-core/inc/driver-models
../codal-core/inc/drivers
../codal-core/inc/streams
../codal-core/inc/types
	)


set(CODAL_CORE_SRC_SKIPPED
../codal-core/source/core/CodalFiber.cpp
)

set(CODAL_CORE_SRC
../codal-core/source/core/CodalCompat.cpp
../codal-core/source/core/CodalComponent.cpp
../codal-core/source/core/CodalDevice.cpp
../codal-core/source/core/CodalDmesg.cpp
../codal-core/source/core/CodalHeapAllocator.cpp
../codal-core/source/core/CodalListener.cpp
../codal-core/source/core/CodalUtil.cpp
../codal-core/source/core/MemberFunctionCallback.cpp
../codal-core/source/driver-models/AbstractButton.cpp
../codal-core/source/driver-models/Accelerometer.cpp
../codal-core/source/driver-models/CodalUSB.cpp
../codal-core/source/driver-models/Compass.cpp
../codal-core/source/driver-models/Display.cpp
../codal-core/source/driver-models/I2C.cpp
../codal-core/source/driver-models/SPI.cpp
../codal-core/source/driver-models/Timer.cpp
../codal-core/source/drivers/AnalogSensor.cpp
../codal-core/source/drivers/AnimatedDisplay.cpp
../codal-core/source/drivers/AsciiKeyMap.cpp
../codal-core/source/drivers/Button.cpp
../codal-core/source/drivers/FXOS8700.cpp
../codal-core/source/drivers/FXOS8700Accelerometer.cpp
../codal-core/source/drivers/FXOS8700Magnetometer.cpp
../codal-core/source/drivers/GhostFAT.cpp
../codal-core/source/drivers/HID.cpp
../codal-core/source/drivers/HIDJoystick.cpp
../codal-core/source/drivers/HIDKeyboard.cpp
../codal-core/source/drivers/HIDMouse.cpp
../codal-core/source/drivers/LEDMatrix.cpp
../codal-core/source/drivers/LIS3DH.cpp
../codal-core/source/drivers/LinearAnalogSensor.cpp
../codal-core/source/drivers/MessageBus.cpp
../codal-core/source/drivers/MultiButton.cpp
../codal-core/source/drivers/NonLinearAnalogSensor.cpp
../codal-core/source/drivers/ST7735.cpp
../codal-core/source/drivers/StandardSPIFlash.cpp
../codal-core/source/drivers/TouchButton.cpp
../codal-core/source/drivers/TouchSensor.cpp
../codal-core/source/drivers/USBMSC.cpp
../codal-core/source/streams/DataStream.cpp
../codal-core/source/streams/LevelDetector.cpp
../codal-core/source/streams/LevelDetectorSPL.cpp
../codal-core/source/streams/StreamNormalizer.cpp
../codal-core/source/streams/Synthesizer.cpp
../codal-core/source/types/BitmapFont.cpp
../codal-core/source/types/CoordinateSystem.cpp
../codal-core/source/types/Event.cpp
../codal-core/source/types/Image.cpp
../codal-core/source/types/ManagedBuffer.cpp
../codal-core/source/types/ManagedString.cpp
../codal-core/source/types/Matrix4.cpp
../codal-core/source/types/RefCounted.cpp
../codal-core/source/types/RefCountedInit.cpp
)

set(CODAL_CORE_NOSRC
)

target_sources(app PRIVATE 
	src/main.cpp 
	src/zfiber.cpp 
	src/ZTimer.cpp 
	src/ZPin.cpp 
	src/ZSPI.cpp 
	src/codal_target_hal.cpp 
	${CODAL_CORE_SRC})
```

## prj.conf
```kconfig
CONFIG_GPIO=y
CONFIG_NEWLIB_LIBC=y
CONFIG_CPLUSPLUS=y
CONFIG_SPI=y
CONFIG_DMA=y

# STM32 options
CONFIG_DMA_1_TX_SUB_CHANNEL_ID=
CONFIG_DMA_2_TX_SUB_CHANNEL_ID=
CONFIG_DMA_STM32F4X=y
CONFIG_CLOCK_STM32_HSE_BYPASS=n
CONFIG_SPI_STM32_INTERRUPT=y
CONFIG_SPI_1=y
CONFIG_SPI_2=y
CONFIG_SPI_3=y
```

## src/main.c
```c
#include <zephyr.h>
#include <board.h>
#include <device.h>
#include <gpio.h>

#define LED_PORT "GPIOC"

#define LED0	5
#define LED1	8
#define LED2	9

void main(void)
{
	int cnt = 0;
	struct device *dev;

	dev = device_get_binding(LED_PORT);

	gpio_pin_configure(dev, LED0, GPIO_DIR_OUT);
	gpio_pin_configure(dev, LED1, GPIO_DIR_OUT);
	gpio_pin_configure(dev, LED2, GPIO_DIR_OUT);

	while (1) {
		gpio_pin_write(dev, LED0, cnt % 3 == 0);
		gpio_pin_write(dev, LED1, cnt % 3 == 1);
		gpio_pin_write(dev, LED2, cnt % 3 == 2);
		cnt++;
		k_sleep(100);
	}
}
```

## src/main.cpp
```c
#include <zephyr.h>
#include <board.h>
#include <device.h>
#include <gpio.h>

#include "CodalComponent.h"
#include "CodalFiber.h"
#include "MessageBus.h"

#include "ZPin.h"
#include "ZSPI.h"
#include "ST7735.h"

using namespace codal;

MessageBus devMessageBus;

#define PINA(n) (0x00 | (n))
#define PINB(n) (0x10 | (n))
#define PINC(n) (0x20 | (n))

#define PIN(name, id) name(DEVICE_ID_IO_P0 + id, id, PIN_CAPABILITY_ALL)

class IO
{
public:
    ZPin led0, led1, led2;
    ZPin tftcs, tftsck, tftrst, tftsda, tftdc;
    ZSPI screenSPI;
    ST7735 screen;
    IO()
        : PIN(led0, PINC(5)), PIN(led1, PINC(8)), PIN(led2, PINC(9)), // leds
          PIN(tftcs, PINB(12)), PIN(tftsck, PINB(13)), PIN(tftrst, PINB(14)), PIN(tftsda, PINB(15)),
          PIN(tftdc, PINB(4)), //
          screenSPI(&tftsda, NULL, &tftsck),
          screen(screenSPI, tftcs, tftdc)
    {
    }
};

void codal_init()
{
    scheduler_init(devMessageBus);

    for (int i = 0; i < DEVICE_COMPONENT_COUNT; i++)
    {
        if (CodalComponent::components[i])
            CodalComponent::components[i]->init();
    }
}

void main(void)
{
    int cnt = 0;

    codal_init();

    auto io = new IO();

    io->led0.setDigitalValue(1);
    io->screenSPI.setFrequency(8 * 1000 * 1000);
    io->screen.init();
    io->screen.configure(0x00, 0x000605);

    io->led0.setDigitalValue(0);

    while (1)
    {
        io->led0.setDigitalValue(cnt % 3 == 0);
        io->led1.setDigitalValue(cnt % 3 == 1);
        io->led2.setDigitalValue(cnt % 3 == 2);

        cnt++;

        fiber_sleep(100);
    }
}
```

## inc/ZPin.h
```c
/*
The MIT License (MIT)

Copyright (c) 2016 British Broadcasting Corporation.
This software is provided by Lancaster University by arrangement with the BBC.

Permission is hereby granted, free of charge, to any person obtaining a
copy of this software and associated documentation files (the "Software"),
to deal in the Software without restriction, including without limitation
the rights to use, copy, modify, merge, publish, distribute, sublicense,
and/or sell copies of the Software, and to permit persons to whom the
Software is furnished to do so, subject to the following conditions:

The above copyright notice and this permission notice shall be included in
all copies or substantial portions of the Software.

THE SOFTWARE IS PROVIDED "AS IS", WITHOUT WARRANTY OF ANY KIND, EXPRESS OR
IMPLIED, INCLUDING BUT NOT LIMITED TO THE WARRANTIES OF MERCHANTABILITY,
FITNESS FOR A PARTICULAR PURPOSE AND NONINFRINGEMENT. IN NO EVENT SHALL
THE AUTHORS OR COPYRIGHT HOLDERS BE LIABLE FOR ANY CLAIM, DAMAGES OR OTHER
LIABILITY, WHETHER IN AN ACTION OF CONTRACT, TORT OR OTHERWISE, ARISING
FROM, OUT OF OR IN CONNECTION WITH THE SOFTWARE OR THE USE OR OTHER
DEALINGS IN THE SOFTWARE.
*/

#ifndef CODAL_Z_PIN_H
#define CODAL_Z_PIN_H

#include "Pin.h"
#include "CodalConfig.h"

#ifndef DEVICE_DEFAULT_PWM_PERIOD
#define DEVICE_DEFAULT_PWM_PERIOD 20000
#endif

/**
 * Class definition for Pin.
 *
 * Commonly represents an I/O pin on the edge connector.
 */
namespace codal
{

struct ZPwmConfig;
struct ZEventConfig;

class ZPin : public codal::Pin
{
protected:
    struct device *port;
    union {
        ZPwmConfig *pwmCfg;
        ZEventConfig *evCfg;
    };

    void config(int status);
    int setPWM(u32_t value, u32_t period);
    static void eventCallback(struct device *port, struct gpio_callback *cb, u32_t pins);

    /**
     * Disconnect any attached mBed IO from this pin.
     *
     * Used only when pin changes mode (i.e. Input/Output/Analog/Digital)
     */
    virtual void disconnect();

    /**
     * Performs a check to ensure that the current Pin is in control of a
     * DynamicPwm instance, and if it's not, allocates a new DynamicPwm instance.
     */
    virtual int obtainAnalogChannel();

    /**
     * Interrupt handler for when an rise interrupt is triggered.
     */
    virtual void onRise();

    /**
     * Interrupt handler for when an fall interrupt is triggered.
     */
    virtual void onFall();

    /**
     * This member function manages the calculation of the timestamp of a pulse detected
     * on a pin whilst in IO_STATUS_EVENT_PULSE_ON_EDGE or IO_STATUS_EVENT_ON_EDGE modes.
     *
     * @param eventValue the event value to distribute onto the message bus.
     */
    virtual void pulseWidthEvent(int eventValue);

    /**
     * This member function will construct an TimedInterruptIn instance, and configure
     * interrupts for rise and fall.
     *
     * @param eventType the specific mode used in interrupt context to determine how an
     *                  edge/rise is processed.
     *
     * @return DEVICE_OK on success
     */
    virtual int enableRiseFallEvents(int eventType);

    /**
     * If this pin is in a mode where the pin is generating events, it will destruct
     * the current instance attached to this DevicePin instance.
     *
     * @return DEVICE_OK on success.
     */
    virtual int disableEvents();

public:
    /**
     * Constructor.
     * Create a DevicePin instance, generally used to represent a pin on the edge connector.
     *
     * @param id the unique EventModel id of this component.
     *
     * @param name the mbed PinName for this DevicePin instance.
     *
     * @param capability the capabilities this DevicePin instance should have.
     *                   (PIN_CAPABILITY_DIGITAL, PIN_CAPABILITY_ANALOG, PIN_CAPABILITY_AD,
     * PIN_CAPABILITY_ALL)
     *
     * @code
     * DevicePin P0(DEVICE_ID_IO_P0, DEVICE_PIN_P0, PIN_CAPABILITY_ALL);
     * @endcode
     */
    ZPin(int id, PinNumber name, PinCapability capability);

    /**
     * Configures this IO pin as a digital output (if necessary) and sets the pin to 'value'.
     *
     * @param value 0 (LO) or 1 (HI)
     *
     * @return DEVICE_OK on success, DEVICE_INVALID_PARAMETER if value is out of range, or
     * DEVICE_NOT_SUPPORTED if the given pin does not have digital capability.
     *
     * @code
     * DevicePin P0(DEVICE_ID_IO_P0, DEVICE_PIN_P0, PIN_CAPABILITY_BOTH);
     * P0.setDigitalValue(1); // P0 is now HI
     * @endcode
     */
    virtual int setDigitalValue(int value);

    /**
     * Configures this IO pin as a digital input (if necessary) and tests its current value.
     *
     *
     * @return 1 if this input is high, 0 if input is LO, or DEVICE_NOT_SUPPORTED
     *         if the given pin does not have digital capability.
     *
     * @code
     * DevicePin P0(DEVICE_ID_IO_P0, DEVICE_PIN_P0, PIN_CAPABILITY_BOTH);
     * P0.getDigitalValue(); // P0 is either 0 or 1;
     * @endcode
     */
    virtual int getDigitalValue();

    /**
     * Configures this IO pin as a digital input with the specified internal pull-up/pull-down
     * configuraiton (if necessary) and tests its current value.
     *
     * @param pull one of the mbed pull configurations: PullUp, PullDown, PullNone
     *
     * @return 1 if this input is high, 0 if input is LO, or DEVICE_NOT_SUPPORTED
     *         if the given pin does not have digital capability.
     *
     * @code
     * DevicePin P0(DEVICE_ID_IO_P0, DEVICE_PIN_P0, PIN_CAPABILITY_BOTH);
     * P0.getDigitalValue(PullUp); // P0 is either 0 or 1;
     * @endcode
     */
    virtual int getDigitalValue(PullMode pull);

    /**
     * Configures this IO pin as an analog/pwm output, and change the output value to the given
     * level.
     *
     * @param value the level to set on the output pin, in the range 0 - 1024
     *
     * @return DEVICE_OK on success, DEVICE_INVALID_PARAMETER if value is out of range, or
     * DEVICE_NOT_SUPPORTED if the given pin does not have analog capability.
     */
    virtual int setAnalogValue(int value);

    /**
     * Configures this IO pin as an analog/pwm output (if necessary) and configures the period to be
     * 20ms, with a duty cycle between 500 us and 2500 us.
     *
     * A value of 180 sets the duty cycle to be 2500us, and a value of 0 sets the duty cycle to be
     * 500us by default.
     *
     * This range can be modified to fine tune, and also tolerate different servos.
     *
     * @param value the level to set on the output pin, in the range 0 - 180.
     *
     * @param range which gives the span of possible values the i.e. the lower and upper bounds
     * (center +/- range/2). Defaults to DEVICE_PIN_DEFAULT_SERVO_RANGE.
     *
     * @param center the center point from which to calculate the lower and upper bounds. Defaults
     * to DEVICE_PIN_DEFAULT_SERVO_CENTER
     *
     * @return DEVICE_OK on success, DEVICE_INVALID_PARAMETER if value is out of range, or
     * DEVICE_NOT_SUPPORTED if the given pin does not have analog capability.
     */
    virtual int setServoValue(int value, int range = DEVICE_PIN_DEFAULT_SERVO_RANGE,
                              int center = DEVICE_PIN_DEFAULT_SERVO_CENTER);

    /**
     * Configures this IO pin as an analogue input (if necessary), and samples the Pin for its
     * analog value.
     *
     * @return the current analogue level on the pin, in the range 0 - 1024, or
     *         DEVICE_NOT_SUPPORTED if the given pin does not have analog capability.
     *
     * @code
     * DevicePin P0(DEVICE_ID_IO_P0, DEVICE_PIN_P0, PIN_CAPABILITY_BOTH);
     * P0.getAnalogValue(); // P0 is a value in the range of 0 - 1024
     * @endcode
     */
    virtual int getAnalogValue();

    /**
     * Determines if this IO pin is currently configured as an input.
     *
     * @return 1 if pin is an analog or digital input, 0 otherwise.
     */
    virtual int isInput();

    /**
     * Determines if this IO pin is currently configured as an output.
     *
     * @return 1 if pin is an analog or digital output, 0 otherwise.
     */
    virtual int isOutput();

    /**
     * Determines if this IO pin is currently configured for digital use.
     *
     * @return 1 if pin is digital, 0 otherwise.
     */
    virtual int isDigital();

    /**
     * Determines if this IO pin is currently configured for analog use.
     *
     * @return 1 if pin is analog, 0 otherwise.
     */
    virtual int isAnalog();

    /**
     * Configures this IO pin as a "makey makey" style touch sensor (if necessary)
     * and tests its current debounced state.
     *
     * Users can also subscribe to DeviceButton events generated from this pin.
     *
     * @return 1 if pin is touched, 0 if not, or DEVICE_NOT_SUPPORTED if this pin does not support
     * touch capability.
     *
     * @code
     * DeviceMessageBus bus;
     *
     * DevicePin P0(DEVICE_ID_IO_P0, DEVICE_PIN_P0, PIN_CAPABILITY_ALL);
     * if(P0.isTouched())
     * {
     *     //do something!
     * }
     *
     * // subscribe to events generated by this pin!
     * bus.listen(DEVICE_ID_IO_P0, DEVICE_BUTTON_EVT_CLICK, someFunction);
     * @endcode
     */
    virtual int isTouched();

    /**
     * Configures this IO pin as an analog/pwm output if it isn't already, configures the period to
     * be 20ms, and sets the pulse width, based on the value it is given.
     *
     * @param pulseWidth the desired pulse width in microseconds.
     *
     * @return DEVICE_OK on success, DEVICE_INVALID_PARAMETER if value is out of range, or
     * DEVICE_NOT_SUPPORTED if the given pin does not have analog capability.
     */
    virtual int setServoPulseUs(int pulseWidth);

    /**
     * Configures the PWM period of the analog output to the given value.
     *
     * @param period The new period for the analog output in milliseconds.
     *
     * @return DEVICE_OK on success, or DEVICE_NOT_SUPPORTED if the
     *         given pin is not configured as an analog output.
     */
    virtual int setAnalogPeriod(int period);

    /**
     * Configures the PWM period of the analog output to the given value.
     *
     * @param period The new period for the analog output in microseconds.
     *
     * @return DEVICE_OK on success, or DEVICE_NOT_SUPPORTED if the
     *         given pin is not configured as an analog output.
     */
    virtual int setAnalogPeriodUs(int period);

    /**
     * Obtains the PWM period of the analog output in microseconds.
     *
     * @return the period on success, or DEVICE_NOT_SUPPORTED if the
     *         given pin is not configured as an analog output.
     */
    virtual uint32_t getAnalogPeriodUs();

    /**
     * Obtains the PWM period of the analog output in milliseconds.
     *
     * @return the period on success, or DEVICE_NOT_SUPPORTED if the
     *         given pin is not configured as an analog output.
     */
    virtual int getAnalogPeriod();

    /**
     * Configures the pull of this pin.
     *
     * @param pull one of the mbed pull configurations: PullUp, PullDown, PullNone
     *
     * @return DEVICE_NOT_SUPPORTED if the current pin configuration is anything other
     *         than a digital input, otherwise DEVICE_OK.
     */
    virtual int setPull(PullMode pull);

    /**
     * Configures the events generated by this DevicePin instance.
     *
     * DEVICE_PIN_EVENT_ON_EDGE - Configures this pin to a digital input, and generates events
     * whenever a rise/fall is detected on this pin. (DEVICE_PIN_EVT_RISE, DEVICE_PIN_EVT_FALL)
     * DEVICE_PIN_EVENT_ON_PULSE - Configures this pin to a digital input, and generates events
     * where the timestamp is the duration that this pin was either HI or LO.
     * (DEVICE_PIN_EVT_PULSE_HI, DEVICE_PIN_EVT_PULSE_LO) DEVICE_PIN_EVENT_ON_TOUCH - Configures
     * this pin as a makey makey style touch sensor, in the form of a DeviceButton. Normal button
     * events will be generated using the ID of this pin. DEVICE_PIN_EVENT_NONE - Disables events
     * for this pin.
     *
     * @param eventType One of: DEVICE_PIN_EVENT_ON_EDGE, DEVICE_PIN_EVENT_ON_PULSE,
     * DEVICE_PIN_EVENT_ON_TOUCH, DEVICE_PIN_EVENT_NONE
     *
     * @code
     * DeviceMessageBus bus;
     *
     * DevicePin P0(DEVICE_ID_IO_P0, DEVICE_PIN_P0, PIN_CAPABILITY_BOTH);
     * P0.eventOn(DEVICE_PIN_EVENT_ON_PULSE);
     *
     * void onPulse(Event evt)
     * {
     *     int duration = evt.timestamp;
     * }
     *
     * bus.listen(DEVICE_ID_IO_P0, DEVICE_PIN_EVT_PULSE_HI, onPulse, MESSAGE_BUS_LISTENER_IMMEDIATE)
     * @endcode
     *
     * @return DEVICE_OK on success, or DEVICE_INVALID_PARAMETER if the given eventype does not
     * match
     *
     * @note In the DEVICE_PIN_EVENT_ON_PULSE mode, the smallest pulse that was reliably detected
     * was 85us, around 5khz. If more precision is required, please use the InterruptIn class
     * supplied by ARM mbed.
     */
    virtual int eventOn(int eventType);
};
} // namespace codal

#endif
```

## inc/ZSPI.h
```c
/*
The MIT License (MIT)

Copyright (c) 2017 Lancaster University.

Permission is hereby granted, free of charge, to any person obtaining a
copy of this software and associated documentation files (the "Software"),
to deal in the Software without restriction, including without limitation
the rights to use, copy, modify, merge, publish, distribute, sublicense,
and/or sell copies of the Software, and to permit persons to whom the
Software is furnished to do so, subject to the following conditions:

The above copyright notice and this permission notice shall be included in
all copies or substantial portions of the Software.

THE SOFTWARE IS PROVIDED "AS IS", WITHOUT WARRANTY OF ANY KIND, EXPRESS OR
IMPLIED, INCLUDING BUT NOT LIMITED TO THE WARRANTIES OF MERCHANTABILITY,
FITNESS FOR A PARTICULAR PURPOSE AND NONINFRINGEMENT. IN NO EVENT SHALL
THE AUTHORS OR COPYRIGHT HOLDERS BE LIABLE FOR ANY CLAIM, DAMAGES OR OTHER
LIABILITY, WHETHER IN AN ACTION OF CONTRACT, TORT OR OTHERWISE, ARISING
FROM, OUT OF OR IN CONNECTION WITH THE SOFTWARE OR THE USE OR OTHER
DEALINGS IN THE SOFTWARE.
*/

#ifndef CODAL_Z_SPI_H
#define CODAL_Z_SPI_H

#include "CodalConfig.h"
#include "zephyr/include/spi.h"
#include "codal-core/inc/driver-models/SPI.h"
#include "Pin.h"
#include "dma.h"

#ifdef CONFIG_SOC_SERIES_STM32F4X
#define ZSPI_DMA_SUPPORTED 1
#endif

namespace codal
{

/**
 * Class definition for SPI service, derived from ARM mbed.
 */
class ZSPI : public codal::SPI
{
protected:
#ifdef ZSPI_DMA_SUPPORTED
    struct dma_config dma_cfg;
    struct dma_block_config dma_block_cfg;
    struct device *dma;
    unsigned dma_chan_id;
    struct k_sem dma_done;

    static void dma_callback(struct device *dev, u32_t id, int error_code);
#endif

    struct spi_config config;
    struct device *dev;
    struct spi_buf_set rxBufSet;
    struct spi_buf rxBuf;
    struct spi_buf_set txBufSet;
    struct spi_buf txBuf;
    uint8_t rxCh, txCh;
public:
    /**
     * Initialize SPI instance with given pins.
     *
     * Default setup is 1 MHz, 8 bit, mode 0.
     */
    ZSPI(codal::Pin &mosi, codal::Pin &miso, codal::Pin &sclk);

    /** Set the frequency of the SPI interface
     *
     * @param frequency The bus frequency in hertz
     */
    virtual int setFrequency(uint32_t frequency);

    /** Set the mode of the SPI interface
     *
     * @param mode Clock polarity and phase mode (0 - 3)
     * @param bits Number of bits per SPI frame (4 - 16)
     *
     * @code
     * mode | POL PHA
     * -----+--------
     *   0  |  0   0
     *   1  |  0   1
     *   2  |  1   0
     *   3  |  1   1
     * @endcode
     */
    virtual int setMode(int mode, int bits = 8);

    /**
     * Writes the given byte to the SPI bus.
     *
     * The CPU will wait until the transmission is complete.
     *
     * @param data The data to write.
     * @return Response from the SPI slave or DEVICE_SPI_ERROR if the the write request failed.
     */
    virtual int write(int data);

    /**
     * Writes and reads from the SPI bus concurrently. Waits un-scheduled for transfer to finish.
     *
     * Either buffer can be NULL.
     */
    virtual int transfer(const uint8_t *txBuffer, uint32_t txSize, uint8_t *rxBuffer,
                         uint32_t rxSize);
};
} // namespace codal

#endif
```

## inc/platform_includes.h
```c
#ifndef PLATFORM_INCLUDES
#define PLATFORM_INCLUDES

#include <stdint.h>
#include <stdlib.h>
#include <string.h>
#include <stdarg.h>
#include <math.h>

#include <zephyr.h>
#include <board.h>
#include <device.h>
#include <gpio.h>

#include <linker/linker-defs.h>

#define PROCESSOR_WORD_TYPE uint32_t
#define DEVICE_STACK_BASE __kernel_ram_end
#define DEVICE_STACK_SIZE 0

#define DEVICE_COMPONENT_COUNT 64

#define FIBER_STACK_SIZE 1024
#define FIBER_PRIORITY -1

#define CODAL_ASSERT(cond)                                                                         \
    if (!(cond))                                                                                   \
    target_panic(909)

#endif
```

## src/ZPin.cpp
```c
/*
The MIT License (MIT)

Copyright (c) 2016 British Broadcasting Corporation.
This software is provided by Lancaster University by arrangement with the BBC.

Permission is hereby granted, free of charge, to any person obtaining a
copy of this software and associated documentation files (the "Software"),
to deal in the Software without restriction, including without limitation
the rights to use, copy, modify, merge, publish, distribute, sublicense,
and/or sell copies of the Software, and to permit persons to whom the
Software is furnished to do so, subject to the following conditions:

The above copyright notice and this permission notice shall be included in
all copies or substantial portions of the Software.

THE SOFTWARE IS PROVIDED "AS IS", WITHOUT WARRANTY OF ANY KIND, EXPRESS OR
IMPLIED, INCLUDING BUT NOT LIMITED TO THE WARRANTIES OF MERCHANTABILITY,
FITNESS FOR A PARTICULAR PURPOSE AND NONINFRINGEMENT. IN NO EVENT SHALL
THE AUTHORS OR COPYRIGHT HOLDERS BE LIABLE FOR ANY CLAIM, DAMAGES OR OTHER
LIABILITY, WHETHER IN AN ACTION OF CONTRACT, TORT OR OTHERWISE, ARISING
FROM, OUT OF OR IN CONNECTION WITH THE SOFTWARE OR THE USE OR OTHER
DEALINGS IN THE SOFTWARE.
*/

/**
 * Class definition for ZPin.
 *
 * Commonly represents an I/O pin on the edge connector.
 */
#include "ZPin.h"
#include "Button.h"
#include "Timer.h"
#include "codal_target_hal.h"
#include "codal-core/inc/types/Event.h"
#include "pwm.h"

#define IO_STATUS_CAN_READ                                                                         \
    (IO_STATUS_DIGITAL_IN | IO_STATUS_EVENT_ON_EDGE | IO_STATUS_EVENT_PULSE_ON_EDGE)

#if CONFIG_SOC_FAMILY_STM32
#define PORTPINS 16
static const char *portNames[] = {
    "GPIOA", "GPIOB", "GPIOC", "GPIOD", "GPIOE", "GPIOF", "GPIOG", "GPIOH",
};
#define NUM_PORTS (sizeof(portNames) / sizeof(portNames[0]))
#else
#error "SOC family for pin not defined"
#endif

#define PINMASK (PORTPINS - 1)

namespace codal
{

struct ZPwmConfig
{
    struct device *pwm;
    u32_t period;
    u32_t pulse;
    uint8_t channel;
};

struct ZEventConfig
{
    struct gpio_callback callback;
    CODAL_TIMESTAMP prevPulse;
    ZPin *parent;
};

inline int map(codal::PullMode pinMode)
{
    switch (pinMode)
    {
    case PullMode::Up:
        return GPIO_PUD_PULL_UP;
    case PullMode::Down:
        return GPIO_PUD_PULL_DOWN;
    case PullMode::None:
        return GPIO_PUD_NORMAL;
    }

    return GPIO_PUD_NORMAL;
}

/**
 * Constructor.
 * Create a ZPin instance, generally used to represent a pin on the edge connector.
 *
 * @param id the unique EventModel id of this component.
 *
 * @param name the mbed PinName for this ZPin instance.
 *
 * @param capability the capabilities this ZPin instance should have.
 *                   (PIN_CAPABILITY_DIGITAL, PIN_CAPABILITY_ANALOG, PIN_CAPABILITY_AD,
 * PIN_CAPABILITY_ALL)
 *
 * @code
 * ZPin P0(DEVICE_ID_IO_P0, DEVICE_PIN_P0, PIN_CAPABILITY_ALL);
 * @endcode
 */
ZPin::ZPin(int id, PinNumber name, PinCapability capability) : codal::Pin(id, name, capability)
{
    this->pullMode = DEVICE_DEFAULT_PULLMODE;

    // Power up in a disconnected, low power state.
    // If we're unused, this is how it will stay...
    this->status = 0x00;
    unsigned portNo = (unsigned)name / PORTPINS;
    CODAL_ASSERT(portNo < NUM_PORTS);
    this->port = device_get_binding(portNames[portNo]);
    CODAL_ASSERT(this->port);

    this->pwmCfg = NULL;
}

void ZPin::config(int status)
{
    int flags = 0;
    int pin = this->name & PINMASK;

    if (this->status & IO_STATUS_ANALOG_OUT)
    {
        delete this->pwmCfg;
        this->pwmCfg = NULL;
    }

    if (this->status & (IO_STATUS_EVENT_ON_EDGE | IO_STATUS_EVENT_PULSE_ON_EDGE))
    {
        CODAL_ASSERT(this->evCfg->parent == this);
        gpio_pin_disable_callback(this->port, pin);
        gpio_remove_callback(this->port, &this->evCfg->callback);
        delete this->evCfg;
        this->evCfg = NULL;
    }

    if (this->status & IO_STATUS_TOUCH_IN)
    {
        delete this->btn;
        this->btn = NULL;
    }

    this->status = status;

    if (status & IO_STATUS_DIGITAL_OUT)
        flags |= GPIO_DIR_OUT;
    else if (status & IO_STATUS_DIGITAL_IN)
        flags |= GPIO_DIR_IN;

    if (status & IO_STATUS_CAN_READ)
        flags |= map(this->pullMode);

    gpio_pin_configure(this->port, pin, flags);
}

/**
 * Configures this IO pin as a digital output (if necessary) and sets the pin to 'value'.
 *
 * @param value 0 (LO) or 1 (HI)
 *
 * @return DEVICE_OK on success, DEVICE_INVALID_PARAMETER if value is out of range, or
 * DEVICE_NOT_SUPPORTED if the given pin does not have digital capability.
 *
 * @code
 * ZPin P0(DEVICE_ID_IO_P0, DEVICE_PIN_P0, PIN_CAPABILITY_BOTH);
 * P0.setDigitalValue(1); // P0 is now HI
 * @endcode
 */
int ZPin::setDigitalValue(int value)
{
    // Check if this pin has a digital mode...
    if (!(PIN_CAPABILITY_DIGITAL & capability))
        return DEVICE_NOT_SUPPORTED;

    // Ensure we have a valid value.
    if (value < 0 || value > 1)
        return DEVICE_INVALID_PARAMETER;

    // Move into a Digital input state if necessary.
    if (!(status & IO_STATUS_DIGITAL_OUT))
    {
        config(IO_STATUS_DIGITAL_OUT);
    }

    return gpio_pin_write(port, name & PINMASK, value);
}

/**
 * Configures this IO pin as a digital input (if necessary) and tests its current value.
 *
 *
 * @return 1 if this input is high, 0 if input is LO, or DEVICE_NOT_SUPPORTED
 *         if the given pin does not have digital capability.
 *
 * @code
 * ZPin P0(DEVICE_ID_IO_P0, DEVICE_PIN_P0, PIN_CAPABILITY_BOTH);
 * P0.getDigitalValue(); // P0 is either 0 or 1;
 * @endcode
 */
int ZPin::getDigitalValue()
{
    // check if this pin has a digital mode...
    if (!(PIN_CAPABILITY_DIGITAL & capability))
        return DEVICE_NOT_SUPPORTED;

    // Move into a Digital input state if necessary.
    if (!(status & IO_STATUS_CAN_READ))
    {
        config(IO_STATUS_DIGITAL_IN);
    }

    u32_t v = 0;
    gpio_pin_read(port, name & PINMASK, &v);

    return v;
}

/**
 * Configures this IO pin as a digital input with the specified internal pull-up/pull-down
 * configuraiton (if necessary) and tests its current value.
 *
 * @param pull one of the mbed pull configurations: PullUp, PullDown, PullNone
 *
 * @return 1 if this input is high, 0 if input is LO, or DEVICE_NOT_SUPPORTED
 *         if the given pin does not have digital capability.
 *
 * @code
 * ZPin P0(DEVICE_ID_IO_P0, DEVICE_PIN_P0, PIN_CAPABILITY_BOTH);
 * P0.getDigitalValue(PullUp); // P0 is either 0 or 1;
 * @endcode
 */
int ZPin::getDigitalValue(PullMode pull)
{
    setPull(pull);
    return getDigitalValue();
}

extern "C" int pinmux_setup_pwm(int pin, struct device **dev, int *channel);

int ZPin::obtainAnalogChannel()
{
    // Move into an analogue output state if necessary
    if (!(status & IO_STATUS_ANALOG_OUT))
    {
        this->config(0);
        auto cfg = this->pwmCfg = new ZPwmConfig;
        cfg->period = DEVICE_DEFAULT_PWM_PERIOD; // 20ms
        cfg->pulse = 0;                          // 0%
        int chan;
        if (pinmux_setup_pwm(this->name, &cfg->pwm, &chan))
            return DEVICE_INVALID_PARAMETER;
        if (chan < 0)
        {
            chan = -chan;
            // TODO what to do about inverted channels?
        }
        cfg->channel = chan;
        status = IO_STATUS_ANALOG_OUT;
    }

    return DEVICE_OK;
}

int ZPin::setPWM(u32_t value, u32_t period)
{
    // check if this pin has an analogue mode...
    if (!(PIN_CAPABILITY_DIGITAL & capability))
        return DEVICE_NOT_SUPPORTED;

    // sanitise the level value
    if (value > period)
        value = period;

    if (obtainAnalogChannel())
        return DEVICE_INVALID_PARAMETER;

    auto cfg = this->pwmCfg;

    cfg->pulse = value;
    cfg->period = period;

    return pwm_pin_set_usec(cfg->pwm, cfg->channel, cfg->period, cfg->pulse);
}

/**
 * Configures this IO pin as an analog/pwm output, and change the output value to the given level.
 *
 * @param value the level to set on the output pin, in the range 0 - 1024
 *
 * @return DEVICE_OK on success, DEVICE_INVALID_PARAMETER if value is out of range, or
 * DEVICE_NOT_SUPPORTED if the given pin does not have analog capability.
 */
int ZPin::setAnalogValue(int value)
{
    // sanitise the level value
    if (value < 0 || value > DEVICE_PIN_MAX_OUTPUT)
        return DEVICE_INVALID_PARAMETER;

    return setPWM((u64_t)value * this->pwmCfg->period / DEVICE_PIN_MAX_OUTPUT,
                  this->pwmCfg->period);
}

/**
 * Configures this IO pin as an analog/pwm output (if necessary) and configures the period to be
 * 20ms, with a duty cycle between 500 us and 2500 us.
 *
 * A value of 180 sets the duty cycle to be 2500us, and a value of 0 sets the duty cycle to be 500us
 * by default.
 *
 * This range can be modified to fine tune, and also tolerate different servos.
 *
 * @param value the level to set on the output pin, in the range 0 - 180.
 *
 * @param range which gives the span of possible values the i.e. the lower and upper bounds (center
 * +/- range/2). Defaults to DEVICE_PIN_DEFAULT_SERVO_RANGE.
 *
 * @param center the center point from which to calculate the lower and upper bounds. Defaults to
 * DEVICE_PIN_DEFAULT_SERVO_CENTER
 *
 * @return DEVICE_OK on success, DEVICE_INVALID_PARAMETER if value is out of range, or
 * DEVICE_NOT_SUPPORTED if the given pin does not have analog capability.
 */
int ZPin::setServoValue(int value, int range, int center)
{
    // check if this pin has an analogue mode...
    if (!(PIN_CAPABILITY_ANALOG & capability))
        return DEVICE_NOT_SUPPORTED;

    // sanitise the servo level
    if (value < 0 || range < 1 || center < 1)
        return DEVICE_INVALID_PARAMETER;

    // clip - just in case
    if (value > DEVICE_PIN_MAX_SERVO_RANGE)
        value = DEVICE_PIN_MAX_SERVO_RANGE;

    // calculate the lower bound based on the midpoint
    int lower = (center - (range / 2)) * 1000;

    value = value * 1000;

    // add the percentage of the range based on the value between 0 and 180
    int scaled = lower + (range * (value / DEVICE_PIN_MAX_SERVO_RANGE));

    return setServoPulseUs(scaled / 1000);
}

/**
 * Configures this IO pin as an analogue input (if necessary), and samples the ZPin for its analog
 * value.
 *
 * @return the current analogue level on the pin, in the range 0 - 1024, or
 *         DEVICE_NOT_SUPPORTED if the given pin does not have analog capability.
 *
 * @code
 * ZPin P0(DEVICE_ID_IO_P0, DEVICE_PIN_P0, PIN_CAPABILITY_BOTH);
 * P0.getAnalogValue(); // P0 is a value in the range of 0 - 1024
 * @endcode
 */
int ZPin::getAnalogValue()
{
    // check if this pin has an analogue mode...
    //    if (!(PIN_CAPABILITY_ANALOG & capability))
    return DEVICE_NOT_SUPPORTED;
}

/**
 * Determines if this IO pin is currently configured as an input.
 *
 * @return 1 if pin is an analog or digital input, 0 otherwise.
 */
int ZPin::isInput()
{
    return (status & (IO_STATUS_DIGITAL_IN | IO_STATUS_ANALOG_IN)) == 0 ? 0 : 1;
}

/**
 * Determines if this IO pin is currently configured as an output.
 *
 * @return 1 if pin is an analog or digital output, 0 otherwise.
 */
int ZPin::isOutput()
{
    return (status & (IO_STATUS_DIGITAL_OUT | IO_STATUS_ANALOG_OUT)) == 0 ? 0 : 1;
}

/**
 * Determines if this IO pin is currently configured for digital use.
 *
 * @return 1 if pin is digital, 0 otherwise.
 */
int ZPin::isDigital()
{
    return (status & (IO_STATUS_DIGITAL_IN | IO_STATUS_DIGITAL_OUT)) == 0 ? 0 : 1;
}

/**
 * Determines if this IO pin is currently configured for analog use.
 *
 * @return 1 if pin is analog, 0 otherwise.
 */
int ZPin::isAnalog()
{
    return (status & (IO_STATUS_ANALOG_IN | IO_STATUS_ANALOG_OUT)) == 0 ? 0 : 1;
}

/**
 * Configures this IO pin as a "makey makey" style touch sensor (if necessary)
 * and tests its current debounced state.
 *
 * Users can also subscribe to Button events generated from this pin.
 *
 * @return 1 if pin is touched, 0 if not, or DEVICE_NOT_SUPPORTED if this pin does not support touch
 * capability.
 *
 * @code
 * DeviceMessageBus bus;
 *
 * ZPin P0(DEVICE_ID_IO_P0, DEVICE_PIN_P0, PIN_CAPABILITY_ALL);
 * if(P0.isTouched())
 * {
 *     //do something!
 * }
 *
 * // subscribe to events generated by this pin!
 * bus.listen(DEVICE_ID_IO_P0, DEVICE_BUTTON_EVT_CLICK, someFunction);
 * @endcode
 */
int ZPin::isTouched()
{
    // check if this pin has a touch mode...
    if (!(PIN_CAPABILITY_DIGITAL & capability))
        return DEVICE_NOT_SUPPORTED;

    // Move into a touch input state if necessary.
    if (!(status & IO_STATUS_TOUCH_IN))
    {
        config(0);
        this->btn = new Button(*this, id);
        status |= IO_STATUS_TOUCH_IN;
    }

    return this->btn->isPressed();
}

/**
 * Configures this IO pin as an analog/pwm output if it isn't already, configures the period to be
 * 20ms, and sets the pulse width, based on the value it is given.
 *
 * @param pulseWidth the desired pulse width in microseconds.
 *
 * @return DEVICE_OK on success, DEVICE_INVALID_PARAMETER if value is out of range, or
 * DEVICE_NOT_SUPPORTED if the given pin does not have analog capability.
 */
int ZPin::setServoPulseUs(int pulseWidth)
{
    // check if this pin has an analogue mode...
    if (!(PIN_CAPABILITY_ANALOG & capability))
        return DEVICE_NOT_SUPPORTED;

    // sanitise the pulse width
    if (pulseWidth < 0)
        return DEVICE_INVALID_PARAMETER;

    return setPWM(pulseWidth, DEVICE_DEFAULT_PWM_PERIOD);
}

/**
 * Configures the PWM period of the analog output to the given value.
 *
 * @param period The new period for the analog output in microseconds.
 *
 * @return DEVICE_OK on success.
 */
int ZPin::setAnalogPeriodUs(int period)
{
    // keep the % of duty cycle
    return setPWM((u64_t)this->pwmCfg->pulse * period / this->pwmCfg->period, period);
}

/**
 * Configures the PWM period of the analog output to the given value.
 *
 * @param period The new period for the analog output in milliseconds.
 *
 * @return DEVICE_OK on success, or DEVICE_NOT_SUPPORTED if the
 *         given pin is not configured as an analog output.
 */
int ZPin::setAnalogPeriod(int period)
{
    return setAnalogPeriodUs(period * 1000);
}

/**
 * Obtains the PWM period of the analog output in microseconds.
 *
 * @return the period on success, or DEVICE_NOT_SUPPORTED if the
 *         given pin is not configured as an analog output.
 */
uint32_t ZPin::getAnalogPeriodUs()
{
    if (!(status & IO_STATUS_ANALOG_OUT))
        return DEVICE_NOT_SUPPORTED;

    return this->pwmCfg->period;
}

/**
 * Obtains the PWM period of the analog output in milliseconds.
 *
 * @return the period on success, or DEVICE_NOT_SUPPORTED if the
 *         given pin is not configured as an analog output.
 */
int ZPin::getAnalogPeriod()
{
    return getAnalogPeriodUs() / 1000;
}

/**
 * Configures the pull of this pin.
 *
 * @param pull one of the mbed pull configurations: PullUp, PullDown, PullNone
 *
 * @return DEVICE_NOT_SUPPORTED if the current pin configuration is anything other
 *         than a digital input, otherwise DEVICE_OK.
 */
int ZPin::setPull(PullMode pull)
{
    pullMode = pull;

    if (status & IO_STATUS_CAN_READ)
        config(status);

    return DEVICE_NOT_SUPPORTED;
}

/**
 * This member function manages the calculation of the timestamp of a pulse detected
 * on a pin whilst in IO_STATUS_EVENT_PULSE_ON_EDGE or IO_STATUS_EVENT_ON_EDGE modes.
 *
 * @param eventValue the event value to distribute onto the message bus.
 */
void ZPin::pulseWidthEvent(int eventValue)
{
    Event evt(id, eventValue, CREATE_ONLY);
    auto now = evt.timestamp;
    auto previous = this->evCfg->prevPulse;

    if (previous != 0)
    {
        evt.timestamp -= previous;
        evt.fire();
    }

    this->evCfg->prevPulse = now;
}

/**
 * Interrupt handler for when an rise interrupt is triggered.
 */
void ZPin::onRise()
{
    if (status & IO_STATUS_EVENT_PULSE_ON_EDGE)
        pulseWidthEvent(DEVICE_PIN_EVT_PULSE_LO);

    if (status & IO_STATUS_EVENT_ON_EDGE)
        Event(id, DEVICE_PIN_EVT_RISE);
}

/**
 * Interrupt handler for when an fall interrupt is triggered.
 */
void ZPin::onFall()
{
    if (status & IO_STATUS_EVENT_PULSE_ON_EDGE)
        pulseWidthEvent(DEVICE_PIN_EVT_PULSE_HI);

    if (status & IO_STATUS_EVENT_ON_EDGE)
        Event(id, DEVICE_PIN_EVT_FALL);
}

void ZPin::eventCallback(struct device *port, struct gpio_callback *cb, u32_t pins)
{
    auto cfg = CONTAINER_OF(cb, ZEventConfig, callback);
    auto pin = cfg->parent;
    u32_t v = 0;
    // this is somewhat suboptimal, since the state of the pin might have changed
    // since the event was rised
    gpio_pin_read(pin->port, pin->name & PINMASK, &v);
    if (v)
        pin->onRise();
    else
        pin->onFall();
}

/**
 * This member function will construct an TimedInterruptIn instance, and configure
 * interrupts for rise and fall.
 *
 * @param eventType the specific mode used in interrupt context to determine how an
 *                  edge/rise is processed.
 *
 * @return DEVICE_OK on success
 */
int ZPin::enableRiseFallEvents(int eventType)
{
    // if we are in neither of the two modes, configure pin as a TimedInterruptIn.
    if (!(status & (IO_STATUS_EVENT_ON_EDGE | IO_STATUS_EVENT_PULSE_ON_EDGE)))
    {
        config(0);
        auto cfg = this->evCfg = new ZEventConfig;
        cfg->parent = this;
        auto pin = this->name & PINMASK;
        gpio_init_callback(&cfg->callback, &ZPin::eventCallback, BIT(pin));
        gpio_add_callback(this->port, &cfg->callback);
        gpio_pin_enable_callback(this->port, pin);
    }

    status &= ~(IO_STATUS_EVENT_ON_EDGE | IO_STATUS_EVENT_PULSE_ON_EDGE);

    // set our status bits accordingly.
    if (eventType == DEVICE_PIN_EVENT_ON_EDGE)
        status |= IO_STATUS_EVENT_ON_EDGE;
    else if (eventType == DEVICE_PIN_EVENT_ON_PULSE)
        status |= IO_STATUS_EVENT_PULSE_ON_EDGE;

    return DEVICE_OK;
}

/**
 * If this pin is in a mode where the pin is generating events, it will destruct
 * the current instance attached to this ZPin instance.
 *
 * @return DEVICE_OK on success.
 */
int ZPin::disableEvents()
{
    if (status & (IO_STATUS_EVENT_ON_EDGE | IO_STATUS_EVENT_PULSE_ON_EDGE | IO_STATUS_TOUCH_IN))
        config(0);

    return DEVICE_OK;
}

/**
 * Configures the events generated by this ZPin instance.
 *
 * DEVICE_PIN_EVENT_ON_EDGE - Configures this pin to a digital input, and generates events whenever
 * a rise/fall is detected on this pin. (DEVICE_PIN_EVT_RISE, DEVICE_PIN_EVT_FALL)
 * DEVICE_PIN_EVENT_ON_PULSE - Configures this pin to a digital input, and generates events where
 * the timestamp is the duration that this pin was either HI or LO. (DEVICE_PIN_EVT_PULSE_HI,
 * DEVICE_PIN_EVT_PULSE_LO) DEVICE_PIN_EVENT_ON_TOUCH - Configures this pin as a makey makey style
 * touch sensor, in the form of a Button. Normal button events will be generated using the ID of
 * this pin. DEVICE_PIN_EVENT_NONE - Disables events for this pin.
 *
 * @param eventType One of: DEVICE_PIN_EVENT_ON_EDGE, DEVICE_PIN_EVENT_ON_PULSE,
 * DEVICE_PIN_EVENT_ON_TOUCH, DEVICE_PIN_EVENT_NONE
 *
 * @code
 * DeviceMessageBus bus;
 *
 * ZPin P0(DEVICE_ID_IO_P0, DEVICE_PIN_P0, PIN_CAPABILITY_BOTH);
 * P0.eventOn(DEVICE_PIN_EVENT_ON_PULSE);
 *
 * void onPulse(Event evt)
 * {
 *     int duration = evt.timestamp;
 * }
 *
 * bus.listen(DEVICE_ID_IO_P0, DEVICE_PIN_EVT_PULSE_HI, onPulse, MESSAGE_BUS_LISTENER_IMMEDIATE)
 * @endcode
 *
 * @return DEVICE_OK on success, or DEVICE_INVALID_PARAMETER if the given eventype does not match
 *
 * @note In the DEVICE_PIN_EVENT_ON_PULSE mode, the smallest pulse that was reliably detected was
 * 85us, around 5khz. If more precision is required, please use the InterruptIn class supplied by
 * ARM mbed.
 */
int ZPin::eventOn(int eventType)
{
    switch (eventType)
    {
    case DEVICE_PIN_EVENT_ON_EDGE:
    case DEVICE_PIN_EVENT_ON_PULSE:
        enableRiseFallEvents(eventType);
        break;

    case DEVICE_PIN_EVENT_ON_TOUCH:
        isTouched();
        break;

    case DEVICE_PIN_EVENT_NONE:
        disableEvents();
        break;

    default:
        return DEVICE_INVALID_PARAMETER;
    }

    return DEVICE_OK;
}
} // namespace codal
```

## src/ZSPI.cpp
```c
/*
The MIT License (MIT)

Copyright (c) 2017 Lancaster University.

Permission is hereby granted, free of charge, to any person obtaining a
copy of this software and associated documentation files (the "Software"),
to deal in the Software without restriction, including without limitation
the rights to use, copy, modify, merge, publish, distribute, sublicense,
and/or sell copies of the Software, and to permit persons to whom the
Software is furnished to do so, subject to the following conditions:

The above copyright notice and this permission notice shall be included in
all copies or substantial portions of the Software.

THE SOFTWARE IS PROVIDED "AS IS", WITHOUT WARRANTY OF ANY KIND, EXPRESS OR
IMPLIED, INCLUDING BUT NOT LIMITED TO THE WARRANTIES OF MERCHANTABILITY,
FITNESS FOR A PARTICULAR PURPOSE AND NONINFRINGEMENT. IN NO EVENT SHALL
THE AUTHORS OR COPYRIGHT HOLDERS BE LIABLE FOR ANY CLAIM, DAMAGES OR OTHER
LIABILITY, WHETHER IN AN ACTION OF CONTRACT, TORT OR OTHERWISE, ARISING
FROM, OUT OF OR IN CONNECTION WITH THE SOFTWARE OR THE USE OR OTHER
DEALINGS IN THE SOFTWARE.
*/

#include "CodalConfig.h"
#include "ZSPI.h"
#include "ErrorNo.h"
#include "CodalDmesg.h"
#include "codal-core/inc/driver-models/Timer.h"
#include "board_pinmux.h"
#include "codal_target_hal.h"

#include "logging/sys_log.h"

#ifdef CONFIG_SOC_SERIES_STM32F4X
#include "drivers/clock_control/stm32_clock_control.h"
#include "zephyr/drivers/spi/spi_ll_stm32.h"
#endif

namespace codal
{

static ZSPI *instances[4];

#define ZERO(f) memset(&f, 0, sizeof(f))
/**
 * Constructor.
 */
ZSPI::ZSPI(Pin &mosi, Pin &miso, Pin &sclk) : codal::SPI()
{
#ifdef ZSPI_DMA_SUPPORTED
    ZERO(dma_cfg);
    ZERO(dma_block_cfg);
    dma = NULL;
    dma_chan_id = 0;
    k_sem_init(&dma_done, 0, 1);
#endif

    pinmux_setup_spi((int)mosi.name, (int)miso.name, (int)sclk.name, &dev);
    ZERO(config);
    ZERO(rxBuf);
    ZERO(txBuf);
    rxBufSet.buffers = &rxBuf;
    rxBufSet.count = 1;
    txBufSet.buffers = &txBuf;
    txBufSet.count = 1;
    setFrequency(1000000);
    setMode(0, 8);

    for (unsigned i = 0; i < ARRAY_SIZE(instances); ++i)
    {
        if (instances[i] == NULL)
            instances[i] = this;
    }
}

/** Set the frequency of the SPI interface
 *
 * @param frequency The bus frequency in hertz
 */
int ZSPI::setFrequency(uint32_t frequency)
{
    config.frequency = frequency;
    return DEVICE_OK;
}

/** Set the mode of the SPI interface
 *
 * @param mode Clock polarity and phase mode (0 - 3)
 * @param bits Number of bits per SPI frame (4 - 16)
 *
 * @code
 * mode | POL PHA
 * -----+--------
 *   0  |  0   0
 *   1  |  0   1
 *   2  |  1   0
 *   3  |  1   1
 * @endcode
 */
int ZSPI::setMode(int mode, int bits)
{
    config.operation = SPI_OP_MODE_MASTER | SPI_TRANSFER_MSB | SPI_WORD_SET(8) | SPI_LINES_SINGLE;

    if (mode & 1)
        config.operation |= SPI_MODE_CPHA;
    if (mode & 2)
        config.operation |= SPI_MODE_CPOL;

    return DEVICE_OK;
}

/**
 * Writes the given byte to the SPI bus.
 *
 * The CPU will wait until the transmission is complete.
 *
 * @param data The data to write.
 * @return Response from the SPI slave or DEVICE_SPI_ERROR if the the write request failed.
 */
int ZSPI::write(int data)
{
    rxCh = 0;
    txCh = data;
    if (transfer(&txCh, 1, &rxCh, 1) < 0)
        return DEVICE_SPI_ERROR;
    return rxCh;
}

void ZSPI::dma_callback(struct device *dev, u32_t id, int error_code)
{
    for (unsigned i = 0; i < ARRAY_SIZE(instances); ++i)
    {
        if (instances[i] && instances[i]->dma == dev && instances[i]->dma_chan_id == id)
        {
            k_sem_give(&instances[i]->dma_done);
            break;
        }
    }
}

/**
 * Writes and reads from the SPI bus concurrently. Waits (possibly un-scheduled) for transfer to
 * finish.
 *
 * Either buffer can be NULL.
 */
int ZSPI::transfer(const uint8_t *txBuffer, uint32_t txSize, uint8_t *rxBuffer, uint32_t rxSize)
{
#ifdef CONFIG_SOC_SERIES_STM32F4X
    // if nothing to read, and we already did some writes, try DMA!
    if (!rxBuffer && txBuf.buf)
    {
        auto spi = ((spi_stm32_config *)dev->config->config_info)->spi;

        dma_cfg.channel_direction = MEMORY_TO_PERIPHERAL;
        dma_cfg.source_data_size = 1;
        dma_cfg.dest_data_size = 1;
        dma_cfg.source_burst_length = 1;
        dma_cfg.dest_burst_length = 1;
        dma_cfg.dma_callback = ZSPI::dma_callback;
        dma_cfg.complete_callback_en = 0; // callback at the end only
        dma_cfg.error_callback_en = 1;    // no error callback
        dma_cfg.block_count = 1;
        dma_cfg.head_block = &dma_block_cfg;

        dma_block_cfg.block_size = txSize;
        dma_block_cfg.source_address = (u32_t)txBuffer;
        dma_block_cfg.dest_address = (u32_t)&spi->DR;

        if (!dma)
        {
            if (spi == SPI1)
            {
                dma = device_get_binding("DMA_2");
                dma_chan_id = 3;
                // chan 3
            }
            else if (spi == SPI2)
            {
                dma = device_get_binding("DMA_1");
                dma_chan_id = 4;
                // chan 0
            }
            else if (spi == SPI3)
            {
                dma = device_get_binding("DMA_1");
                dma_chan_id = 5;
                // chan 0
            }
            else
            {
                CODAL_ASSERT(0);
            }
        }

        // dma_chan_id is reall STM32 stream

        if (dma_config(dma, dma_chan_id, &dma_cfg))
        {
            return DEVICE_SPI_ERROR;
        }

        if (dma_start(dma, dma_chan_id))
        {
            return DEVICE_SPI_ERROR;
        }

        // enable SPI if not done yet
        if (!(spi->CR1 & SPI_CR1_SPE))
            spi->CR1 |= SPI_CR1_SPE;

        // Enable the SPI Error Interrupt Bit
        spi->CR2 |= SPI_CR2_ERRIE;

        // Enable Tx DMA Request
        spi->CR2 |= SPI_CR2_TXDMAEN;

        k_sem_take(&dma_done, K_FOREVER);

        return DEVICE_OK;
    }
#endif
    rxBuf.buf = rxBuffer;
    rxBuf.len = rxSize;
    txBuf.buf = (uint8_t *)txBuffer;
    txBuf.len = txSize;
    if (spi_transceive(dev, &config, txSize ? &txBufSet : NULL, rxSize ? &rxBufSet : NULL) < 0)
        return DEVICE_SPI_ERROR;
    
    return 0;
}

} // namespace codal
```

## src/codal_target_hal.cpp
```c
#include "codal_target_hal.h"
#include "CodalDmesg.h"

#include <misc/reboot.h>
#include <misc/printk.h>

void target_enable_irq()
{
    irq_unlock(0);
}

void target_disable_irq()
{
    irq_lock();
}

void target_wait_for_event()
{
    k_yield();
}

void target_wait(uint32_t milliseconds)
{
    k_busy_wait(milliseconds * 1000);
}

void target_reset()
{
    sys_reboot(0);
}

void target_panic(int statusCode)
{
    target_disable_irq();

    printk("*** CODAL PANIC : [%d]", statusCode);

#if DEVICE_DMESG_BUFFER_SIZE > 0
    DMESG("*** CODAL PANIC : [%d]", statusCode);
#endif

    for (;;)
        ;
}

PROCESSOR_WORD_TYPE codal_heap_start = (PROCESSOR_WORD_TYPE)(&_end);
```
